## CMakeLists.txt
```
# Zephyr application build for the OSOlogic MCU tier.
#   west build -b rpi_pico   firmware/osodb-mcu/zephyr
#   west build -b esp32_devkitc_wroom/esp32/procpu firmware/osodb-mcu/zephyr
# Regenerate ../generated/board_map.c for your board first: make gen BOARD=<name>.
# (C) 2026 Roig Borrell S.L. and Ibercomp S.L. — AGPL-3.0-or-later
cmake_minimum_required(VERSION 3.20.0)
find_package(Zephyr REQUIRED HINTS $ENV{ZEPHYR_BASE})
project(osodb_mcu)

target_sources(app PRIVATE
  ${CMAKE_CURRENT_SOURCE_DIR}/../src/osodb_embedded.c
  ${CMAKE_CURRENT_SOURCE_DIR}/../src/pid.c
  ${CMAKE_CURRENT_SOURCE_DIR}/../src/federation.c
  ${CMAKE_CURRENT_SOURCE_DIR}/../src/scan.c
  ${CMAKE_CURRENT_SOURCE_DIR}/../generated/board_map.c
  ${CMAKE_CURRENT_SOURCE_DIR}/src/hal_zephyr.c
  ${CMAKE_CURRENT_SOURCE_DIR}/src/main.c)

target_include_directories(app PRIVATE
  ${CMAKE_CURRENT_SOURCE_DIR}/../src
  ${CMAKE_CURRENT_SOURCE_DIR}/../generated)

# inject Zephyr mutex locking into the portable core
target_compile_definitions(app PRIVATE OSODB_PORT_HEADER="osodb_port_zephyr.h")
```

## west.yml
```
# west manifest — pin the Zephyr revision the MCU tier is built against.
# Init once:  west init -l firmware/osodb-mcu/zephyr && west update
# (C) 2026 Roig Borrell S.L. and Ibercomp S.L. — AGPL-3.0-or-later
manifest:
  remotes:
    - name: zephyrproject
      url-base: https://github.com/zephyrproject-rtos
  projects:
    - name: zephyr
      remote: zephyrproject
      revision: v3.7.0        # LTS; bump deliberately
      import: true
```

## prj.conf
```kconfig
# Base Zephyr config for the OSOlogic MCU tier. Federation runs over the console UART
# by default (portable, works everywhere); enable networking + MQTT per board/overlay.
# (C) 2026 Roig Borrell S.L. and Ibercomp S.L. — AGPL-3.0-or-later
CONFIG_GPIO=y
CONFIG_ADC=y
CONFIG_PWM=y
CONFIG_LOG=y
CONFIG_CBPRINTF_FP_SUPPORT=y     # %f/%g for tag values
CONFIG_MAIN_STACK_SIZE=4096
CONFIG_FPU=y
```

## src/main.c
```c
/*
 * Zephyr entry point for the OSOlogic MCU tier.
 * A pinned, cooperative scan thread runs the control loop at a fixed period; a second
 * thread reads federation lines from the console UART ("SET <id> <value>"). The tag
 * table is protected by osodb_mtx (see osodb_port_zephyr.h).
 *
 * (C) 2026 Roig Borrell S.L. and Ibercomp S.L. — AGPL-3.0-or-later
 */
#include <zephyr/kernel.h>
#include <zephyr/console/console.h>
#include "osodb_embedded.h"
#include "board_map.h"
#include "scan.h"
#include "federation.h"

#define SCAN_MS 100

struct k_mutex osodb_mtx;      /* referenced by osodb_port_zephyr.h */
static osodb_t db;

/* federation output over the console UART */
void federation_emit(const char *line)
{
    printk("%s\n", line);
}

static void federation_thread(void *a, void *b, void *c)
{
    ARG_UNUSED(a); ARG_UNUSED(b); ARG_UNUSED(c);
    console_getline_init();
    for (;;) {
        char *line = console_getline();          /* blocks on the console UART */
        if (line) {
            federation_handle_line(&db, line, k_uptime_get_32());
        }
    }
}
K_THREAD_DEFINE(fed_tid, 1024, federation_thread, NULL, NULL, NULL, 7, 0, 0);

int main(void)
{
    k_mutex_init(&osodb_mtx);
    osodb_init(&db);
    board_io_define(&db);
    board_io_init();

    uint32_t last = k_uptime_get_32();
    for (;;) {
        uint32_t now = k_uptime_get_32();
        double dt = (now - last) / 1000.0;
        last = now;
        scan_step(&db, dt, now);
        k_msleep(SCAN_MS);
    }
    return 0;
}
```

## src/hal_zephyr.c
```c
/*
 * hal_zephyr — SCAFFOLD implementation of hal.h on Zephyr.
 *
 * Zephyr addresses GPIO/ADC/PWM through devicetree specs, not flat pin numbers, so the
 * board.yaml pin ids are mapped here to `gpio_dt_spec` / PWM / ADC channels via a small
 * table the integrator fills from the board's devicetree (aliases/overlay). One LED
 * alias is wired as a worked example; complete the rest per board. This is the only
 * file that changes when porting to a new Zephyr board — the control core does not.
 *
 * (C) 2026 Roig Borrell S.L. and Ibercomp S.L. — AGPL-3.0-or-later
 */
#include "hal.h"
#include <zephyr/kernel.h>
#include <zephyr/drivers/gpio.h>

/* Example: map board.yaml gpio pin 25 -> the board's "led0" alias. Extend this table
 * (and add ADC/PWM equivalents) for every pin your profile uses. */
static const struct gpio_dt_spec led0 =
    GPIO_DT_SPEC_GET_OR(DT_ALIAS(led0), gpios, {0});

static const struct gpio_dt_spec *gpio_lookup(hal_io_t pin)
{
    switch (pin) {
    case 25: return &led0;        /* machine.run in the rp2040_demo profile */
    default: return NULL;         /* TODO: add the rest for your board */
    }
}

void hal_gpio_config(hal_io_t pin, bool is_output, bool active_low)
{
    const struct gpio_dt_spec *g = gpio_lookup(pin);
    if (!g || !device_is_ready(g->port)) {
        return;
    }
    gpio_flags_t f = is_output ? GPIO_OUTPUT_INACTIVE : GPIO_INPUT;
    if (active_low) {
        f |= GPIO_ACTIVE_LOW;
    }
    gpio_pin_configure_dt(g, f);
}

bool hal_gpio_read(hal_io_t pin)
{
    const struct gpio_dt_spec *g = gpio_lookup(pin);
    return (g && device_is_ready(g->port)) ? gpio_pin_get_dt(g) > 0 : false;
}

void hal_gpio_write(hal_io_t pin, bool level)
{
    const struct gpio_dt_spec *g = gpio_lookup(pin);
    if (g && device_is_ready(g->port)) {
        gpio_pin_set_dt(g, level ? 1 : 0);
    }
}

/* TODO: implement against the ADC / PWM drivers for your board (adc_dt_spec, pwm_dt_spec). */
void     hal_pwm_config(hal_io_t pin) { ARG_UNUSED(pin); }
void     hal_adc_config(hal_io_t channel) { ARG_UNUSED(channel); }
uint16_t hal_adc_read(hal_io_t channel) { ARG_UNUSED(channel); return 0; }
void     hal_pwm_write(hal_io_t pin, double duty_0_1) { ARG_UNUSED(pin); ARG_UNUSED(duty_0_1); }

uint32_t hal_now_ms(void) { return k_uptime_get_32(); }
```
